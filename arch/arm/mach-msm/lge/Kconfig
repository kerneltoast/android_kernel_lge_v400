## arch/arm/mach-msm/lge/Kconfig
```kconfig
config MACH_LGE
	bool

menu "LGE Board Selection"

config MACH_MSM8226_E7WIFI
        depends on ARCH_MSM8226
        select MACH_LGE
        bool "APQ8026 E7WIFI OPEN"
        help
          Support for the Qualcomm APQ8026 E7 WiFi-Only device.

endmenu

config LGE_PM_BATTERY_CAPACITY_4000mAh
        bool "Support Battery Capacity : 4000mAh"
        depends on LGE_PM_BATTERY_PROFILE_DATA
        help
          LGE battery capacity for 4000mAh
```
